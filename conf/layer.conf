## conf/layer.conf
```bitbake
# We have a conf and classes directory, append to BBPATH
BBPATH .= ":${LAYERDIR}"

# We have a recipes directory, add to BBFILES
BBFILES += "${LAYERDIR}/recipes*/*/*.bb ${LAYERDIR}/recipes*/*/*.bbappend"

BBFILE_COLLECTIONS += "meta-cubieboard"
BBFILE_PATTERN_meta-cubieboard := "^${LAYERDIR}/"
BBFILE_PRIORITY_meta-cubieboard = "10"

# This should only be incremented on significant changes that will
# cause compatibility issues with other layers
LAYERVERSION_meta-cubieboard = "1"

LAYERDEPENDS_meta-cubieboard = "core openembedded-layer"

LAYERSERIES_COMPAT_meta-cubieboard = "dunfell"
```
